## sdkconfig.defaults
```kconfig
# ------------------------------------------------------------
# Octal PSRAM (8MB) — S3N16R8
# ------------------------------------------------------------
CONFIG_ESP32_SPIRAM_SUPPORT=y
CONFIG_SPIRAM_MODE_OCT=y
CONFIG_SPIRAM_TYPE_ESPPSRAM64=y
CONFIG_SPIRAM_SPEED_80M=y
CONFIG_SPIRAM_USE_CAPS_ALLOC=y
CONFIG_SPIRAM_ALLOW_BSS_SEG_EXTERNAL_MEMORY=y
CONFIG_SPIRAM_CACHE_WORKAROUND=y

# ------------------------------------------------------------
# mbedTLS — 有 PSRAM 后可启用硬件加速，增大 SSL 缓冲区
# ------------------------------------------------------------
# 关闭硬件加密引擎，让 SSL 内存走 PSRAM（避免与 DMA 内存池竞争）
CONFIG_MBEDTLS_HARDWARE_SHA=n
CONFIG_MBEDTLS_HARDWARE_AES=n
CONFIG_MBEDTLS_SSL_MAX_CONTENT_LEN=16384

# ------------------------------------------------------------
# DMA 内存
# ------------------------------------------------------------
CONFIG_ESP_DMA_RESERVE_LEN=3
```
