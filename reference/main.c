/* USER CODE BEGIN Header */
/**
  ******************************************************************************
  * @file           : main.c
  * @brief          : Main program body
  ******************************************************************************
  * @attention
  *
  * Copyright (c) 2025 STMicroelectronics.
  * All rights reserved.
  *
  * This software is licensed under terms that can be found in the LICENSE file
  * in the root directory of this software component.
  * If no LICENSE file comes with this software, it is provided AS-IS.
  *
  ******************************************************************************
  */
/* USER CODE END Header */
/* Includes ------------------------------------------------------------------*/
#include "main.h"
#include "cmsis_os.h"
#include "can.h"
#include "dac.h"
#include "dma.h"
#include "fatfs.h"
#include "i2c.h"
#include "sdio.h"
#include "spi.h"
#include "tim.h"
#include "usart.h"
#include "gpio.h"

/* Private includes ----------------------------------------------------------*/
/* USER CODE BEGIN Includes */
#include "math.h"
#include "draw.h"
#include <stdio.h>

//#include <math.h>
#include <string.h> // 需要包含这个头文件来使用 memcpy
#define PI 3.14159
/* USER CODE END Includes */

/* Private typedef -----------------------------------------------------------*/
/* USER CODE BEGIN PTD */

/* USER CODE END PTD */

/* Private define ------------------------------------------------------------*/
/* USER CODE BEGIN PD */

/* USER CODE END PD */

/* Private macro -------------------------------------------------------------*/
/* USER CODE BEGIN PM */

/* USER CODE END PM */

/* Private variables ---------------------------------------------------------*/

/* USER CODE BEGIN PV */
uint16_t volume =160;
uint8_t pitch =60;
uint32_t last_interrupt_time=0;
uint32_t current_time=0;
uint8_t func=0;
static int freq=500;
static int count_S=0;
uint8_t percentage=5;
volatile int8_t Game_Input_Dir = -1; // 0:UP, 1:DOWN, 2:LEFT, 3:RIGHT

// --- SD Waveform Variables ---
#define SD_WAVE_MAX_LEN 16384 // 16KB Dedicated Audio Buffer
uint8_t Audio_Buffer[SD_WAVE_MAX_LEN]; // Dedicated Buffer
uint8_t *SD_Wave_Buffer; // Pointer to store raw audio data (Points to Audio_Buffer)
uint32_t SD_Wave_Len = 0;                // Actual length of loaded data
volatile uint32_t SD_Wave_Idx = 0;       // Current playback position (Read Head) - Modified by ISR
volatile uint32_t SD_Wave_Write_Idx = 0; // Current write position (Write Head)
uint32_t SD_Wave_Total_Data_Left = 0;    // Bytes remaining in file
uint8_t SD_Wave_Loaded = 0;              // Flag: 1 if playing, 0 otherwise
uint8_t Video_Mode = 0;                  // 0: Audio Only, 1: Video (4-Channel)

extern uint16_t DAC_Buff_X[]; // Defined in draw.c
// -----------------------------

// --- FatFS Variables (Moved to Global to avoid Stack Overflow) ---
FATFS fs;
FIL fil;
uint8_t test_buff[512];
// -----------------------------------------------------------------

int scale=60;
//#define LENGTH 32
//int Music_Score[LENGTH]={60,0,60,0,67,0,67,0,69,0,69,0,67,0,0,0,65,0,65,0,64,0,64,0,62,0,62,0,60,0,0,0};
//#define LENGTH 32
//uint8_t Music_Score[LENGTH]={55,62,55,62,55,62,55,57,57,64,57,64,57,64,57,59,59,62,59,62,59,62,59,61,50,57,50,57,50,57,50,55};
#define LENGTH 624
uint8_t Music_Score[LENGTH]={
	
	0,0,0,0,0,0,0,0,0,0,0,0,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65
	
};
	
	
//音色
	//三角波
	//#define LENGTH_OF_WAVE 32
	//uint8_t Wave[LENGTH_OF_WAVE]={50,51,52,53,54,55,56,57,58,59,60,61,62,63,64,65,66,67,68,69,70,71,72,73,74,75,76,77,78,79,80,81};
	//方波
	#define LENGTH_OF_WAVE 10
	uint8_t Wave[LENGTH_OF_WAVE]={90,90,90,90,90,0,0,0,0,0};
//uint8_t datt[18000]={0x80,0x7F,0x80,0x7F,0x80,0x7F,0x80,0x7F,0x80,0x7F,0x80,0x80,0x81,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0x7D,0x7C};
uint8_t datt[18]={0};
/* USER CODE END PV */

/* Private function prototypes -----------------------------------------------*/
void SystemClock_Config(void);
void MX_FREERTOS_Init(void);
/* USER CODE BEGIN PFP */

/* USER CODE END PFP */

/* Private user code ---------------------------------------------------------*/
/* USER CODE BEGIN 0 */

/* USER CODE END 0 */

/**
  * @brief  The application entry point.
  * @retval int
  */
int main(void)
{

  /* USER CODE BEGIN 1 */
  FRESULT res;
  // FATFS fs; // Moved to global
  // FIL fil;  // Moved to global
  char sd_buf[32];
  UINT bw;
  /* USER CODE END 1 */

  /* MCU Configuration--------------------------------------------------------*/

  /* Reset of all peripherals, Initializes the Flash interface and the Systick. */
  HAL_Init();

  /* USER CODE BEGIN Init */
  DRAW_AddString("SYSTEM INIT...", 12, 0, 0, 100, 100);//示波器显示字符串
  DRAW_AddCircle(50, 50, 30);//示波器显示圆形
  DRAW_AddLine(0, 0, 200, 200);//示波器显示直线
  DRAW_AddRect(100, 100, 50, 50);//示波器显示矩形
  DRAW_Terminal_Print("HAL INIT DONE\n");//示波器终端打印字符串
  DRAW_Clear();//清除示波器显示
  /* USER CODE END Init */

  /* Configure the system clock */
  SystemClock_Config();

  /* USER CODE BEGIN SysInit */

  /* USER CODE END SysInit */

  /* Initialize all configured peripherals */
  MX_GPIO_Init();
  MX_DMA_Init();
  MX_CAN1_Init();
  MX_DAC_Init();
  MX_I2C1_Init();
  MX_SPI1_Init();
  MX_USART1_UART_Init();
  MX_TIM14_Init();
  MX_TIM2_Init();
  MX_TIM8_Init();
  MX_TIM3_Init();
  MX_SDIO_SD_Init();
  MX_FATFS_Init();
  MX_TIM6_Init();
  /* USER CODE BEGIN 2 */
  SD_Wave_Buffer = Audio_Buffer; // Initialize pointer to Dedicated Audio Buffer
  /* 初始化绘图库 */
  DRAW_Init(1000); 
  HAL_TIM_Base_Start(&htim6);  // Start TIM6 for DAC DMA trigger
  
  // Initialize Terminal Mode (Scale 12%, Spacing 100)
  DRAW_Terminal_Init(12, 100);
  DRAW_Terminal_Print("SYSTEM BOOT...\n");
	
  __HAL_TIM_SET_COMPARE(&htim2, TIM_CHANNEL_3, 0); // Ensure PWM is 0 at startup
	HAL_TIM_PWM_Start(&htim2, TIM_CHANNEL_3);
  __HAL_TIM_SET_COMPARE(&htim2, TIM_CHANNEL_1, 0); // Ensure PWM is 0 at startup
	HAL_TIM_PWM_Start(&htim2, TIM_CHANNEL_1);
	HAL_TIM_Base_Start_IT(&htim3);
	HAL_TIM_Encoder_Start(&htim8, TIM_CHANNEL_ALL);

  /* USER CODE END 2 */

  /* Call init function for freertos objects (in cmsis_os2.c) */
  MX_FREERTOS_Init();

  /* Start scheduler */
  osKernelStart();

  /* We should never get here as control is now taken by the scheduler */

  /* Infinite loop */
  /* USER CODE BEGIN WHILE */
  int count = 0;
  char buf[32];
	char buf1[32];
   //DRAW_Clear();
   DRAW_Terminal_Print("abcdefghijklmnopqrstuvwxyz");
   //DRAW_AddString("c", 100, 0, 0, 100, 100);
#if 0
  while (1)
  {
    // 1. 格式化变量到字符串
    
    
    // 2. 清除旧的显示内容
    
    
    // 3. 重新添加显示对象
    //DRAW_AddString("COUNT", 200, 0, 3000, 20, 20); // 静态标题
    
    
    // 4. 添加符号测试
    //DRAW_AddString("!#%*+-=/,:;.?", 100, 0, 500, 10, 10);
    //DRAW_AddString("@$<|>~", 100, 0, 0, 10, 10);
    
    // 5. 更新变量
    //count++;
    //if(count > 9999) count = 0;
    
    // 6. 延时刷新 (例如 200ms 更新一次)
    //HAL_Delay(200);
    
		HAL_GPIO_TogglePin(LED_GPIO_Port,LED_Pin);

        // --- Alphabet Test ---
        static uint32_t last_print = 0;
        static int alpha_idx = 0;
        const char alpha_map[] = "ABCDEFGHIJKLMNOPQRSTUVWXYZabcdefghijklmnopqrstuvwxyz";

        if(HAL_GetTick() - last_print > 500)
        {
             last_print = HAL_GetTick();
             char s[2] = {0};
             s[0] = alpha_map[alpha_idx];
             DRAW_Terminal_Print(s);
             
             alpha_idx++;
             if(alpha_map[alpha_idx] == '\0') alpha_idx = 0;
        }
        // ---------------------
	
		static uint16_t encoder=0;
		static uint16_t last_encoder=0;
		encoder=__HAL_TIM_GET_COUNTER(&htim8);
		int delta=encoder-last_encoder;
		if(delta>1000||delta<-1000)delta=0;
		last_encoder=encoder;
		if(func==0){volume+=delta/4;}
		if(func==1){pitch+=delta/4;scale=pitch;}
		
		//HAL_GPIO_TogglePin(GPIOC,GPIO_PIN_13);
		//uint8_t write_Buffer[]="Hello!";
		//uint8_t read_Buffer[300]={0};
		//SPI_Flash_PageWrite(0x00000000, write_Buffer, sizeof(write_Buffer)); // 内部包含写使能和等待
		//SPI_Flash_ReadData(0x10F0, read_Buffer, sizeof(read_Buffer));
		//HAL_Delay(10);
		
		if(count_S==LENGTH)count_S=0;
		
		if(func==2){scale=Music_Score[count_S];HAL_Delay(0);}
		
		if(func==2){scale=Music_Score[count_S];HAL_Delay(0);}
		
        // --- SD Waveform Logic ---
        if(SD_Wave_Loaded)
        {
            // Streaming Logic
            // Calculate buffered bytes
            uint32_t buffered;
            uint32_t current_read_idx = SD_Wave_Idx; // Snapshot volatile variable
            
            if(SD_Wave_Write_Idx >= current_read_idx)
                buffered = SD_Wave_Write_Idx - current_read_idx;
            else
                buffered = SD_WAVE_MAX_LEN - (current_read_idx - SD_Wave_Write_Idx);
            
            // If buffer is less than half full, refill
            if(buffered < (SD_WAVE_MAX_LEN / 2))
            {
                UINT br;
                uint32_t to_read = 4096; // Read 4KB chunks
                FRESULT res;
                
                // Determine where to write
                uint32_t space_at_end = SD_WAVE_MAX_LEN - SD_Wave_Write_Idx;
                
                if(to_read > space_at_end)
                {
                    // Split read
                    res = f_read(&fil, &SD_Wave_Buffer[SD_Wave_Write_Idx], space_at_end, &br);
                    if(res != FR_OK) { char err[20]; sprintf(err, "E1:%d\n", res); DRAW_Terminal_Print(err); }
                    
                    if(br < space_at_end) { 
                        f_lseek(&fil, 44); 
                        // Try reading rest from start
                        UINT br2;
                        f_read(&fil, &SD_Wave_Buffer[SD_Wave_Write_Idx + br], space_at_end - br, &br2);
                    } 
                    
                    res = f_read(&fil, &SD_Wave_Buffer[0], to_read - space_at_end, &br);
                    if(res != FR_OK) { char err[20]; sprintf(err, "E2:%d\n", res); DRAW_Terminal_Print(err); }
                    
                    if(br < (to_read - space_at_end)) { 
                        f_lseek(&fil, 44);
                        UINT br2;
                        f_read(&fil, &SD_Wave_Buffer[br], (to_read - space_at_end) - br, &br2);
                    }
                    
                    SD_Wave_Write_Idx = to_read - space_at_end;
                }
                else
                {
                    res = f_read(&fil, &SD_Wave_Buffer[SD_Wave_Write_Idx], to_read, &br);
                    if(res != FR_OK) { char err[20]; sprintf(err, "E3:%d\n", res); DRAW_Terminal_Print(err); }
                    
                    if(br < to_read) { 
                        f_lseek(&fil, 44); 
                        UINT br2;
                        f_read(&fil, &SD_Wave_Buffer[SD_Wave_Write_Idx + br], to_read - br, &br2);
                    } 
                    
                    SD_Wave_Write_Idx += to_read;
                    if(SD_Wave_Write_Idx >= SD_WAVE_MAX_LEN) SD_Wave_Write_Idx = 0;
                }
            }
            
            // If playing WAV, do NOT change timer frequency for music notes
            count_S++;
            
            // Minimal delay to allow interrupts to process but keep loop fast
            HAL_Delay(1); 
        }
        else
        {
            // Original Music Logic
            freq=440*pow(2,(scale-69.0)/12.0)*LENGTH_OF_WAVE/2;
            int AAR = 1e6/freq;
            __HAL_TIM_SET_AUTORELOAD(&htim3,AAR ); // 使用宏设置//播放音乐请注释
            count_S++;
            
            HAL_Delay(70); // Original delay for music mode
        }
        // -------------------------
        
		//HAL_GPIO_WritePin(GPIOC,GPIO_PIN_13,GPIO_PIN_SET);
		/*DRAW_Clear();
        
		//HAL_GPIO_WritePin(GPIOC,GPIO_PIN_13,GPIO_PIN_SET);
		/*DRAW_Clear();
		if(func==0){DRAW_AddString("VOL MODE", 100, 1500, 1500, 10, 10);}
		if(func==1){DRAW_AddString("PITCH MODE", 100, 1500, 1500, 10, 10);}
		if(func==2){DRAW_AddString("MUSIC MODE", 100, 1500, 1500, 10, 10);}
		sprintf(buf, "%d", scale);
		sprintf(buf1, "%d", volume);
		
		
		DRAW_AddString("MIDI CODE", 100, 0, 3000, 10, 10); // 静态标题
		DRAW_AddString(buf, 100, 3000, 3000, 20, 20);     // 动态数值
		DRAW_AddString("VOL", 100, 1500, 2000, 10, 10); // 静态标题
		DRAW_AddString(buf1, 100, 3000, 2000, 20, 20);     // 动态数值
		*/
		HAL_Delay(70);
		
		//HAL_GPIO_WritePin(GPIOC,GPIO_PIN_13,GPIO_PIN_RESET);
		//HAL_Delay(150);
  }
#endif
    /* USER CODE END WHILE */

    /* USER CODE BEGIN 3 */
  // }
  /* USER CODE END 3 */
}

/**
  * @brief System Clock Configuration
  * @retval None
  */
void SystemClock_Config(void)
{
  RCC_OscInitTypeDef RCC_OscInitStruct = {0};
  RCC_ClkInitTypeDef RCC_ClkInitStruct = {0};

  /** Configure the main internal regulator output voltage
  */
  __HAL_RCC_PWR_CLK_ENABLE();
  __HAL_PWR_VOLTAGESCALING_CONFIG(PWR_REGULATOR_VOLTAGE_SCALE1);

  /** Initializes the RCC Oscillators according to the specified parameters
  * in the RCC_OscInitTypeDef structure.
  */
  RCC_OscInitStruct.OscillatorType = RCC_OSCILLATORTYPE_HSI;
  RCC_OscInitStruct.HSIState = RCC_HSI_ON;
  RCC_OscInitStruct.HSICalibrationValue = RCC_HSICALIBRATION_DEFAULT;
  RCC_OscInitStruct.PLL.PLLState = RCC_PLL_ON;
  RCC_OscInitStruct.PLL.PLLSource = RCC_PLLSOURCE_HSI;
  RCC_OscInitStruct.PLL.PLLM = 8;
  RCC_OscInitStruct.PLL.PLLN = 168;
  RCC_OscInitStruct.PLL.PLLP = RCC_PLLP_DIV2;
  RCC_OscInitStruct.PLL.PLLQ = 7;
  if (HAL_RCC_OscConfig(&RCC_OscInitStruct) != HAL_OK)
  {
    Error_Handler();
  }

  /** Initializes the CPU, AHB and APB buses clocks
  */
  RCC_ClkInitStruct.ClockType = RCC_CLOCKTYPE_HCLK|RCC_CLOCKTYPE_SYSCLK
                              |RCC_CLOCKTYPE_PCLK1|RCC_CLOCKTYPE_PCLK2;
  RCC_ClkInitStruct.SYSCLKSource = RCC_SYSCLKSOURCE_PLLCLK;
  RCC_ClkInitStruct.AHBCLKDivider = RCC_SYSCLK_DIV1;
  RCC_ClkInitStruct.APB1CLKDivider = RCC_HCLK_DIV4;
  RCC_ClkInitStruct.APB2CLKDivider = RCC_HCLK_DIV2;

  if (HAL_RCC_ClockConfig(&RCC_ClkInitStruct, FLASH_LATENCY_5) != HAL_OK)
  {
    Error_Handler();
  }
}

/* USER CODE BEGIN 4 */
void HAL_GPIO_EXTI_Callback(uint16_t GPIO_Pin)
{
  uint32_t current_time = HAL_GetTick();
  if(current_time - last_interrupt_time < 100) return; // Debounce
  last_interrupt_time = current_time;

  if(GPIO_Pin == RS_Pin)
  {
      func++;
      if(func==3)func=0;
      if(func==2)count_S=0;
  }
  else if(GPIO_Pin == KEY_UP_Pin)
  {
      Game_Input_Dir = 0; // UP
      
      // Original Logic
      percentage+=1;
      if(percentage>10)percentage=0;
      for(int i=0;i<10;i++) Wave[i]=0;
      for(int i=0;i<percentage;i++) Wave[i]=90;
  }
  else if(GPIO_Pin == KEY_DOWN_Pin)
  {
      Game_Input_Dir = 1; // DOWN
  }
  else if(GPIO_Pin == KEY_LEFT_Pin)
  {
      Game_Input_Dir = 2; // LEFT
  }
  else if(GPIO_Pin == KEY_RIGHT_Pin)
  {
      Game_Input_Dir = 3; // RIGHT
  }
}
/* HAL_TIM_PeriodElapsedCallback for TIM3 moved to the bottom of the file */


/* USER CODE END 4 */

/**
  * @brief  Period elapsed callback in non blocking mode
  * @note   This function is called  when TIM7 interrupt took place, inside
  * HAL_TIM_IRQHandler(). It makes a direct call to HAL_IncTick() to increment
  * a global variable "uwTick" used as application time base.
  * @param  htim : TIM handle
  * @retval None
  */
void HAL_TIM_PeriodElapsedCallback(TIM_HandleTypeDef *htim)
{
  /* USER CODE BEGIN Callback 0 */

  /* USER CODE END Callback 0 */
  if (htim->Instance == TIM7)
  {
    HAL_IncTick();
  }
  /* USER CODE BEGIN Callback 1 */
  if(htim->Instance == TIM3)
  {
        // --- SD Waveform Playback ---
        if(SD_Wave_Loaded)
        {
            if(Video_Mode)
            {
                // 4-Channel Mode: [L, R, X, Y] (16-bit each)
                // Buffer is uint8_t* pointing to uint16_t array.
                // We need to read 4 samples (8 bytes).
                
                // Check bounds
                if(SD_Wave_Idx + 8 > SD_WAVE_MAX_LEN) SD_Wave_Idx = 0;
                
                // Audio (Channel 1) -> TIM2 CH3
                // Data is Little Endian.
                int16_t audio_sample = (int16_t)(SD_Wave_Buffer[SD_Wave_Idx] | (SD_Wave_Buffer[SD_Wave_Idx+1] << 8));
                
                // X (Channel 3) -> DAC1
                int16_t x_sample = (int16_t)(SD_Wave_Buffer[SD_Wave_Idx+4] | (SD_Wave_Buffer[SD_Wave_Idx+5] << 8));
                
                // Y (Channel 4) -> DAC2
                int16_t y_sample = (int16_t)(SD_Wave_Buffer[SD_Wave_Idx+6] | (SD_Wave_Buffer[SD_Wave_Idx+7] << 8));
                
                // Output
                // Audio: Convert signed 16-bit to unsigned PWM (0-4095)
                // (sample + 32768) >> 4
                uint16_t pwm_val = (uint16_t)((audio_sample + 32768) >> 4);
                __HAL_TIM_SET_COMPARE(&htim2, TIM_CHANNEL_3, pwm_val * volume / 100);
                __HAL_TIM_SET_COMPARE(&htim2, TIM_CHANNEL_1, pwm_val * volume / 100);
                
                // DAC: 12-bit (0-4095)
                // Note: DAC Output Buffer is DISABLED, so impedance matching is important.
                // If the image is distorted, check if the load is too low.
                uint16_t dac_x = (uint16_t)((x_sample + 32768) >> 4);
                uint16_t dac_y = (uint16_t)((y_sample + 32768) >> 4);
                
                HAL_DAC_SetValue(&hdac, DAC_CHANNEL_1, DAC_ALIGN_12B_R, dac_x);
                HAL_DAC_SetValue(&hdac, DAC_CHANNEL_2, DAC_ALIGN_12B_R, dac_y);
                
                SD_Wave_Idx += 8;
            }
            else
            {
                // SD_Wave_Idx++; // Removed incorrect increment
                if(SD_Wave_Idx >= SD_WAVE_MAX_LEN) SD_Wave_Idx = 0; // Wrap Buffer
                
                // Audio Only Mode (Assuming 16-bit Mono WAV)
                // Read 2 bytes per sample
                
                // Check bounds
                if(SD_Wave_Idx + 2 > SD_WAVE_MAX_LEN) SD_Wave_Idx = 0;
                
                int16_t audio_sample = (int16_t)(SD_Wave_Buffer[SD_Wave_Idx] | (SD_Wave_Buffer[SD_Wave_Idx+1] << 8));
                
                // Convert signed 16-bit to 12-bit PWM (0-4095)
                uint16_t pwm_val = (uint16_t)((audio_sample + 32768) >> 4);
                __HAL_TIM_SET_COMPARE(&htim2, TIM_CHANNEL_3, pwm_val * volume / 100);
                __HAL_TIM_SET_COMPARE(&htim2, TIM_CHANNEL_1, pwm_val * volume / 100);
                
                SD_Wave_Idx += 2;
            }
        }
        else
        {
            // Fallback to internal generated wave
            static short int wave_counter=0;
            wave_counter++;
            if(wave_counter==LENGTH_OF_WAVE)wave_counter=0;
            
            // Scale 8-bit wave sample (0-255) to 12-bit PWM (0-4095)
            // __HAL_TIM_SET_COMPARE(&htim2, TIM_CHANNEL_3, (Wave[wave_counter] << 4) * volume / 100);
            
            // Silence on startup / Idle
            __HAL_TIM_SET_COMPARE(&htim2, TIM_CHANNEL_3, 0);
            __HAL_TIM_SET_COMPARE(&htim2, TIM_CHANNEL_1, 0);
        }
  }
  /* USER CODE END Callback 1 */
}

/**
  * @brief  This function is executed in case of error occurrence.
  * @retval None
  */
void Error_Handler(void)
{
  /* USER CODE BEGIN Error_Handler_Debug */
  /* User can add his own implementation to report the HAL error return state */
  // __disable_irq(); 
  while (1)
  {
      HAL_GPIO_TogglePin(LED_GPIO_Port, LED_Pin);
      HAL_Delay(100); // 快速闪烁表示错误
  }
  /* USER CODE END Error_Handler_Debug */
}
#ifdef USE_FULL_ASSERT
/**
  * @brief  Reports the name of the source file and the source line number
  *         where the assert_param error has occurred.
  * @param  file: pointer to the source file name
  * @param  line: assert_param error line source number
  * @retval None
  */
void assert_failed(uint8_t *file, uint32_t line)
{
  /* USER CODE BEGIN 6 */
  /* User can add his own implementation to report the file name and line number,
     ex: printf("Wrong parameters value: file %s on line %d\r\n", file, line) */
  /* USER CODE END 6 */
}
#endif /* USE_FULL_ASSERT */
